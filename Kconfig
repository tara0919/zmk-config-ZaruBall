## Kconfig
```kconfig
# Copyright (c) 2026 The ZMK Contributors
# SPDX-License-Identifier: MIT

config ZARUBALL_BATTERY_TEXT
    bool "Type both ZaruBall battery levels"
    default y
    depends on SHIELD_ZARUBALL_RIGHT
    depends on ZMK_BATTERY_REPORTING
    depends on ZMK_SPLIT_ROLE_CENTRAL
    depends on ZMK_SPLIT_BLE_CENTRAL_BATTERY_LEVEL_FETCHING

config ZARUBALL_IME_ACTIVITY
    bool "Restore Japanese IME on scroll activity"
    default y
    depends on SHIELD_ZARUBALL_RIGHT
    depends on ZMK_POINTING
```

## config/west.yml
```yaml
manifest:
  remotes:
    - name: zmkfirmware
      url-base: https://github.com/zmkfirmware
    - name: badjeff
      url-base: https://github.com/badjeff
    - name: caksoylar
      url-base: https://github.com/caksoylar
    - name: kot149
      url-base: https://github.com/kot149
  projects:
    - name: zmk
      remote: zmkfirmware
      revision: v0.3
      import: app/west.yml
    - name: zmk-pmw3610-driver
      remote: badjeff
      revision: zmk-0.3
    - name: zmk-rgbled-widget
      remote: caksoylar
      revision: v0.3-branch
    - name: zmk-mouse-gesture
      remote: kot149
      revision: v1
  self:
    path: config
```

## dts/bindings/behaviors/zmk,behavior-battery-text.yaml
```yaml
# Copyright (c) 2026 The ZMK Contributors
# SPDX-License-Identifier: MIT

description: Type the central and peripheral battery levels

compatible: "zmk,behavior-battery-text"

include: zero_param.yaml
```

## dts/bindings/input_processors/zmk,input-processor-axis-keys.yaml
```yaml
# Copyright (c) 2026 The ZMK Contributors
# SPDX-License-Identifier: MIT

description: Input processor that converts signed relative-axis movement into key taps

compatible: "zmk,input-processor-axis-keys"

include: ip_zero_param.yaml

properties:
  type:
    type: int
    required: true
  code:
    type: int
    required: true
  threshold:
    type: int
    required: true
    description: Accumulated movement required for one key tap
  min-interval-ms:
    type: int
    required: true
    description: Minimum time between generated key taps
  tap-ms:
    type: int
    required: true
    description: Time between each generated key press and release
  bindings:
    type: phandle-array
    required: true
    description: Negative-direction binding followed by positive-direction binding
```

## dts/bindings/input_processors/zmk,input-processor-ime-activity.yaml
```yaml
description: Track layer activity and restore the IME when the layer exits

compatible: "zmk,input-processor-ime-activity"

include: ip_zero_param.yaml

properties:
  layer:
    type: int
    required: true

  enter-keycode:
    type: int
    required: true

  exit-keycode:
    type: int
    required: true
```

## dts/bindings/input_processors/zmk,input-processor-inertial-scroll.yaml
```yaml
# Copyright (c) 2026 The ZMK Contributors
# SPDX-License-Identifier: MIT

description: Input processor for adding decaying inertial scroll after wheel input stops

compatible: "zmk,input-processor-inertial-scroll"

properties:
  "#input-processor-cells":
    type: int
    required: true
    const: 0
  track-remainders:
    type: boolean
  type:
    type: int
    required: true
  codes:
    type: array
    required: true
  output-code:
    type: int
    default: 8
  axis-lock:
    type: boolean
    description: Lock XY input to the dominant axis and map X/Y to horizontal/vertical scroll
  axis-lock-threshold:
    type: int
    default: 4
    description: Minimum accumulated movement before choosing an axis
  axis-lock-ratio-percent:
    type: int
    default: 150
    description: Dominant-to-secondary axis ratio required for an immediate decision
  axis-lock-max-pending:
    type: int
    default: 12
    description: Total accumulated movement after which the larger axis is chosen
  axis-lock-release-ms:
    type: int
    default: 80
    description: Idle time across both axes before the selected axis is released
  interval-ms:
    type: int
    default: 16
  gain-percent:
    type: int
    default: 100
  velocity-percent:
    type: int
    default: 100
  min-velocity:
    type: int
    default: 0
  start-threshold:
    type: int
    default: 1
  burst-threshold:
    type: int
    default: 1
  burst-peak-threshold:
    type: int
    default: 1
  burst-peak-percent:
    type: int
    default: 0
  burst-timeout-ms:
    type: int
    default: 120
  burst-window-ms:
    type: int
    default: 80
  release-ms:
    type: int
    default: 40
  candidate-tail-base-ms:
    type: int
    default: 0
  candidate-tail-per-peak-ms:
    type: int
    default: 0
  candidate-tail-max-ms:
    type: int
    default: 0
  decay-percent:
    type: int
    default: 78
  tail-decay-percent:
    type: int
    default: 78
  tail-threshold:
    type: int
    default: 0
  stop-threshold:
    type: int
    default: 35
  max-step:
    type: int
    default: 4
  cancel-layer:
    type: int
    default: -1
```
